/** ###################################################################
**     THIS BEAN MODULE IS GENERATED BY THE TOOL. DO NOT MODIFY IT.
**     Filename  : UART.C
**     Project   : FlyWeight
**     Processor : MC9S08GT60CFD
**     Beantype  : AsynchroSerial
**     Version   : Bean 02.333, Driver 01.12, CPU db: 2.87.074
**     Compiler  : Metrowerks HCS08 C Compiler
**     Date/Time : 3/29/2006, 2:59 PM
**     Abstract  :
**         This bean "AsynchroSerial" implements an asynchronous serial
**         communication. The bean supports different settings of
**         parity, word width, stop-bit and communication speed,
**         user can select interrupt or polling handler.
**         Communication speed can be changed also in runtime.
**         The bean requires one on-chip asynchronous serial channel.
**     Settings  :
**         Serial channel              : SCI1
**
**         Protocol
**             Init baud rate          : 38400baud
**             Width                   : 8 bits
**             Stop bits               : 1
**             Parity                  : none
**             Breaks                  : Disabled
**
**         Registers
**             Input buffer            : SCI1D     [001F]
**             Output buffer           : SCI1D     [001F]
**             Control register        : SCI1C1    [001A]
**             Mode register           : SCI1C2    [001B]
**             Baud setting reg.       : SCI1BD    [0018]
**             Special register        : SCI1S1    [001C]
**
**         Input interrupt
**             Vector name             : Vsci1rx
**
**         Output interrupt
**             Vector name             : Vsci1tx
**
**         Used pins:
**         ----------------------------------------------------------
**           Function | On package           |    Name
**         ----------------------------------------------------------
**            Input   |     11               |  PTE1_RxD1
**            Output  |     10               |  PTE0_TxD1
**             RTS    |     36               |  PTA1_KBI1P1
**         ----------------------------------------------------------
**
**             Note: RTS pin is NOT supported by hardware.
**                   It is handled by software.
**
**
**     Contents  :
**         RecvChar        - byte UART_RecvChar(UART_TComData *Chr);
**         SendChar        - byte UART_SendChar(UART_TComData Chr);
**         RecvBlock       - byte UART_RecvBlock(UART_TComData *Ptr,word Size,word *Rcv);
**         SendBlock       - byte UART_SendBlock(UART_TComData *Ptr,word Size,word *Snd);
**         ClearRxBuf      - byte UART_ClearRxBuf(void);
**         ClearTxBuf      - byte UART_ClearTxBuf(void);
**         GetCharsInRxBuf - word UART_GetCharsInRxBuf(void);
**         GetCharsInTxBuf - word UART_GetCharsInTxBuf(void);
**
**     (c) Copyright UNIS, spol. s r.o. 1997-2005
**     UNIS, spol. s r.o.
**     Jundrovska 33
**     624 00 Brno
**     Czech Republic
**     http      : www.processorexpert.com
**     mail      : info@processorexpert.com
** ###################################################################*/


/* MODULE UART. */

#pragma MESSAGE DISABLE C4002 /* WARNING C4002: Result not used is ignored */

#include "UART.h"
#include "Events.h"



#define OVERRUN_ERR      0x01          /* Overrun error flag bit   */
#define COMMON_ERR       0x02          /* Common error of RX       */
#define CHAR_IN_RX       0x04          /* Char is in RX buffer     */
#define RUNINT_FROM_TX   0x08          /* Interrupt is in progress */
#define FULL_RX          0x10          /* Full receive buffer      */
#define FULL_TX          0x20          /* Full transmit buffer     */

static byte SerFlag;                   /* Flags for serial communication */
                                       /* Bit 0 - Overrun error */
                                       /* Bit 1 - Common error of RX */
                                       /* Bit 2 - Char in RX buffer */
                                       /* Bit 3 - Interrupt is in progress */
                                       /* Bit 4 - Full RX buffer */
                                       /* Bit 5 - Full TX buffer */
byte UART_InpLen;                      /* Length of the input buffer content */
static byte InpIndxR;                  /* Index for reading from input buffer */
static byte InpIndxW;                  /* Index for writing to input buffer */
static UART_TComData InpBuffer[UART_INP_BUF_SIZE]; /* Input buffer for SCI commmunication */
byte UART_OutLen;                      /* Length of the output buffer content */
static byte OutIndxR;                  /* Index for reading from output buffer */
static byte OutIndxW;                  /* Index for writing to output buffer */
static UART_TComData OutBuffer[UART_OUT_BUF_SIZE]; /* Output buffer for SCI commmunication */


/*
** ===================================================================
**     Method      :  UART_RecvChar (bean AsynchroSerial)
**
**     Description :
**         If any data is received, this method returns one
**         character, otherwise it returns an error code (it does
**         not wait for data). This method is enabled only if the
**         receiver property is enabled. 
**         DMA mode:
**         If DMA controller is available on the selected CPU and
**         the receiver is configured to use DMA controller then
**         this method only sets the selected DMA channel. Then the
**         status of the DMA transfer can be checked using
**         GetCharsInRxBuf method. See an example of a typical usage
**         for details about the communication using DMA.
**     Parameters  :
**         NAME            - DESCRIPTION
**       * Chr             - Pointer to a received character
**     Returns     :
**         ---             - Error code, possible codes:
**                           ERR_OK - OK
**                           ERR_SPEED - This device does not work in
**                           the active speed mode
**                           ERR_RXEMPTY - No data in receiver
**                           ERR_BREAK - Break character is detected(only when <Interrupt service> property
**                           is disabled)
**                           ERR_COMMON - common error occurred (the
**                           GetError method can be used for error
**                           specification)
**                           DMA mode:
**                           If DMA controller is available on the
**                           selected CPU and the receiver is
**                           configured to use DMA controller then
**                           only ERR_OK, ERR_RXEMPTY, and ERR_SPEED
**                           error code can be returned from this
**                           method.
** ===================================================================
*/
byte UART_RecvChar(UART_TComData *Chr)
{
  byte Result = ERR_OK;                /* Return error code */

  if(UART_InpLen > 0) {                /* Is number of received chars greater than 0? */
    EnterCritical();                   /* Save the PS register */
    UART_InpLen--;                     /* Decrease number of received chars */
    *Chr = InpBuffer[InpIndxR];        /* Received char */
    if (++InpIndxR >= UART_INP_BUF_SIZE) /* Is the index out of the buffer? */
      InpIndxR = 0;                    /* Set the index to the start of the buffer */
    if(UART_InpLen <= UART_RTS_BUF_SIZE)
      PTAD &= ~0x02;                   /* Set RTS to the low level */
    Result = (byte)((SerFlag & (OVERRUN_ERR|COMMON_ERR|FULL_RX))?ERR_COMMON:ERR_OK);
    SerFlag &= ~(OVERRUN_ERR|COMMON_ERR|FULL_RX|CHAR_IN_RX); /* Clear all errors in the status variable */
    ExitCritical();                    /* Restore the PS register */
  } else {
    return ERR_RXEMPTY;                /* Receiver is empty */
  }
  return Result;                       /* Return error code */
}

/*
** ===================================================================
**     Method      :  UART_SendChar (bean AsynchroSerial)
**
**     Description :
**         Sends one character to the channel. If the bean is
**         temporarily disabled (Disable method) SendChar method
**         only stores data into an output buffer. In case of a zero
**         output buffer size, only one character can be stored.
**         Enabling the bean (Enable method) starts the transmission
**         of the stored data. This method is available only if the
**         transmitter property is enabled.
**         DMA mode:
**         If DMA controller is available on the selected CPU and
**         the transmitter is configured to use DMA controller then
**         this method only sets selected DMA channel. Then the
**         status of the DMA transfer can be checked using
**         GetCharsInTxBuf method. See an example of a typical usage
**         for details about communication using DMA.
**     Parameters  :
**         NAME            - DESCRIPTION
**         Chr             - Character to send
**     Returns     :
**         ---             - Error code, possible codes:
**                           ERR_OK - OK
**                           ERR_SPEED - This device does not work in
**                           the active speed mode
**                           ERR_TXFULL - Transmitter is full
** ===================================================================
*/
byte UART_SendChar(UART_TComData Chr)
{
  if(UART_OutLen == UART_OUT_BUF_SIZE) /* Is number of chars in buffer is the same as a size of the transmit buffer */
    return ERR_TXFULL;                 /* If yes then error */
  EnterCritical();                     /* Save the PS register */
  UART_OutLen++;                       /* Increase number of bytes in the transmit buffer */
  OutBuffer[OutIndxW] = Chr;           /* Store char to buffer */
  if (++OutIndxW >= UART_OUT_BUF_SIZE) /* Is the index out of the buffer? */
    OutIndxW = 0;                      /* Set the index to the start of the buffer */
  SCI1C2_TIE = 1;                      /* Enable transmit interrupt */
  ExitCritical();                      /* Restore the PS register */
  return ERR_OK;                       /* OK */
}

/*
** ===================================================================
**     Method      :  UART_RecvBlock (bean AsynchroSerial)
**
**     Description :
**         If any data is received, this method returns the block of
**         the data and its length (and incidental error), otherwise
**         it returns an error code (it does not wait for data).
**         This method is available only if non-zero length of the
**         input buffer is defined and the receiver property is
**         enabled.
**         DMA mode:
**         If DMA controller is available on the selected CPU and
**         the receiver is configured to use DMA controller then
**         this method only sets the selected DMA channel. Then the
**         status of the DMA transfer can be checked using
**         GetCharsInRxBuf method. See an example of a typical usage
**         for details about communication using DMA.
**     Parameters  :
**         NAME            - DESCRIPTION
**       * Ptr             - Pointer to the block of received data
**         Size            - Size of the block
**       * Rcv             - Pointer to real number of the received
**                           data
**     Returns     :
**         ---             - Error code, possible codes:
**                           ERR_OK - OK
**                           ERR_SPEED - This device does not work in
**                           the active speed mode
**                           ERR_RXEMPTY - No data in receiver
**                           ERR_VALUE - Parameter is out of range.
**                           ERR_COMMON - common error occurred (the
**                           GetError method can be used for error
**                           specification)
**                           DMA mode:
**                           If DMA controller is available on the
**                           selected CPU and the receiver is
**                           configured to use DMA controller then
**                           only ERR_OK, ERR_RXEMPTY, and ERR_SPEED
**                           error codes can be returned from this
**                           method.
** ===================================================================
*/
byte UART_RecvBlock(UART_TComData *Ptr, word Size, word *Rcv)
{
  word count;                          /* Number of received chars */
  byte result = ERR_OK;                /* Last error */

  for(count = 0; count < Size; count++) {
    result = UART_RecvChar(Ptr++);
    if(result != ERR_OK) {             /* Receiving given number of chars */
      break;                           /* Break data block receiving */
    }
  }
  *Rcv = count;                        /* Return number of received chars */
  return result;                       /* Return last error code*/
}

/*
** ===================================================================
**     Method      :  UART_SendBlock (bean AsynchroSerial)
**
**     Description :
**         Sends a block of characters to the channel.
**         This method is available only if non-zero length of the
**         output buffer is defined and the transmitter property is
**         enabled.
**         DMA mode:
**         If DMA controller is available on the selected CPU and
**         the transmitter is configured to use DMA controller then
**         this method only sets the selected DMA channel. Then the
**         status of the DMA transfer can be checked using
**         GetCharsInTxBuf method. See typical usage for details
**         about communication using DMA.
**     Parameters  :
**         NAME            - DESCRIPTION
**       * Ptr             - Pointer to the block of data to send
**         Size            - Size of the block
**       * Snd             - Pointer to number of data that are sent
**                           (moved to buffer)
**     Returns     :
**         ---             - Error code, possible codes:
**                           ERR_OK - OK
**                           ERR_SPEED - This device does not work in
**                           the active speed mode
**                           ERR_TXFULL - It was not possible to send
**                           requested number of bytes
** ===================================================================
*/
byte UART_SendBlock(UART_TComData * Ptr, word Size, word *Snd)
{
  word count;                          /* Number of sent chars */
  byte result = ERR_OK;                /* Last error */

  for(count = 0; count < Size; count++) {
    result = UART_SendChar(*Ptr++);
    if(result != ERR_OK) {             /* Sending given number of chars */
      break;                           /* Break data block sending */
    }
  }
  *Snd = count;                        /* Return number of sent chars */
  return result;                       /* Return last error code*/
}

/*
** ===================================================================
**     Method      :  UART_ClearRxBuf (bean AsynchroSerial)
**
**     Description :
**         Clears the receive buffer.
**         This method is available only if non-zero length of the
**         input buffer is defined and the receiver property is
**         enabled.
**         DMA mode:
**         If DMA controller is available on the selected CPU and
**         the receiver is configured to use DMA controller then
**         this method only stops selected DMA channel.
**     Parameters  : None
**     Returns     :
**         ---             - Error code, possible codes:
**                           ERR_OK - OK
**                           ERR_SPEED - This device does not work in
**                           the active speed mode
** ===================================================================
*/
byte UART_ClearRxBuf(void)
{
  EnterCritical();                     /* Save the PS register */
  UART_InpLen = 0;                     /* Set number of chars in the transmit buffer to 0 */
  InpIndxR = InpIndxW = 0;             /* Reset indices */
  ExitCritical();                      /* Restore the PS register */
  return ERR_OK;                       /* OK */
}

/*
** ===================================================================
**     Method      :  UART_ClearTxBuf (bean AsynchroSerial)
**
**     Description :
**         Clears the transmit buffer.
**         This method is available only if non-zero length of the
**         output buffer is defined and the receiver property is
**         enabled.
**         DMA mode:
**         If DMA controller is available on the selected CPU and
**         the transmitter is configured to use DMA controller then
**         this method only stops selected DMA channel.
**     Parameters  : None
**     Returns     :
**         ---             - Error code, possible codes:
**                           ERR_OK - OK
**                           ERR_SPEED - This device does not work in
**                           the active speed mode
** ===================================================================
*/
byte UART_ClearTxBuf(void)
{
  EnterCritical();                     /* Save the PS register */
  UART_OutLen = 0;                     /* Set number of chars in the receive buffer to 0 */
  OutIndxR = OutIndxW = 0;             /* Reset indices */
  ExitCritical();                      /* Restore the PS register */
  return ERR_OK;                       /* OK */
}

/*
** ===================================================================
**     Method      :  UART_GetCharsInRxBuf (bean AsynchroSerial)
**
**     Description :
**         Returns the number of characters in the input buffer.
**         This method is available only if the receiver property is
**         enabled.
**         DMA mode:
**         If DMA controller is available on the selected CPU and
**         the receiver is configured to use DMA controller then
**         this method returns the number of characters in the
**         receive buffer.
**     Parameters  : None
**     Returns     :
**         ---             - The number of characters in the input
**                           buffer.
** ===================================================================
*/
/*
word UART_GetCharsInRxBuf(void)

**      This method is implemented as a macro. See header module. **
*/

/*
** ===================================================================
**     Method      :  UART_GetCharsInTxBuf (bean AsynchroSerial)
**
**     Description :
**         Returns the number of characters in the output buffer.
**         This method is available only if the transmitter property
**         is enabled.
**         DMA mode:
**         If DMA controller is available on the selected CPU and
**         the transmitter is configured to use DMA controller then
**         this method returns the number of characters in the
**         transmit buffer.
**     Parameters  : None
**     Returns     :
**         ---             - The number of characters in the output
**                           buffer.
** ===================================================================
*/
/*
word UART_GetCharsInTxBuf(void)

**      This method is implemented as a macro. See header module. **
*/

/*
** ===================================================================
**     Method      :  UART_InterruptRx (bean AsynchroSerial)
**
**     Description :
**         The method services the receive interrupt of the selected 
**         peripheral(s) and eventually invokes the bean's event(s).
**         This method is internal. It is used by Processor Expert only.
** ===================================================================
*/
#define ON_ERROR      1
#define ON_FULL_RX    2
#define ON_RX_CHAR    4
#define ON_IDLE_CHAR  8
ISR(UART_InterruptRx)
{
  UART_TComData Data;                  /* Temporary variable for data */
  byte StatReg = getReg(SCI1S1);
  byte OnFlags = 0;                    /* Temporary variable for flags */

  PTAD |= 0x02;
  Data = SCI1D;                        /* Read data from the receiver */
  if(UART_InpLen < UART_INP_BUF_SIZE) { /* Is number of bytes in the receive buffer lower than size of buffer? */
    UART_InpLen++;                     /* Increse number of chars in the receive buffer */
    InpBuffer[InpIndxW] = Data;        /* Save received char to the receive buffer */
    if (++InpIndxW >= UART_INP_BUF_SIZE) /* Is the index out of the buffer? */
      InpIndxW = 0;                    /* Set the index to the start of the buffer */
    OnFlags |= ON_RX_CHAR;             /* Set flag "OnRXChar" */
  } else {
    SerFlag |= FULL_RX;                /* If yes then set flag buffer overflow */
    OnFlags |= ON_ERROR;               /* Set flag "OnError" */
  }
  if(OnFlags & ON_ERROR) {             /* Was error flag detect? */
    UART_OnError();                    /* If yes then invoke user event */
  }
  else {
    if(OnFlags & ON_RX_CHAR) {         /* Is OnRxChar flag set? */
      UART_OnRxChar();                 /* If yes then invoke user event */
    }
    if(OnFlags & ON_FULL_RX) {         /* Is OnFullRxBuf flag set? */
      UART_OnFullRxBuf();              /* If yes then invoke user event */
    }
  }
  if(UART_InpLen < UART_RTS_BUF_SIZE)  /* Is number of chars in the receive buffer lower than size of the RTS buffer? */
    /* PTAD: PTAD1=0 */
    PTAD &= ~0x02;                     /* Set RTS to low level */
}

/*
** ===================================================================
**     Method      :  UART_InterruptTx (bean AsynchroSerial)
**
**     Description :
**         The method services the transmit interrupt of the selected 
**         peripheral(s) and eventually invokes the bean's event(s).
**         This method is internal. It is used by Processor Expert only.
** ===================================================================
*/
#define ON_FREE_TX  1
#define ON_TX_CHAR  2
ISR(UART_InterruptTx)
{
  byte OnFlags = 0;                    /* Temporary variable for flags */

  if(SerFlag & RUNINT_FROM_TX)         /* Is flag "running int from TX" set? */
    OnFlags |= ON_TX_CHAR;             /* Set flag "OnTxChar" */
  SerFlag &= ~RUNINT_FROM_TX;          /* Reset flag "running int from TX" */
  if(UART_OutLen) {                    /* Is number of bytes in the transmit buffer greater then 0? */
    UART_OutLen--;                     /* Decrease number of chars in the transmit buffer */
    SerFlag |= RUNINT_FROM_TX;         /* Set flag "running int from TX"? */
    SCI1S1;                            /* Reset interrupt request flag */
    SCI1D = OutBuffer[OutIndxR];       /* Store char to transmitter register */
    if (++OutIndxR >= UART_OUT_BUF_SIZE) /* Is the index out of the buffer? */
      OutIndxR = 0;                    /* Set the index to the start of the buffer */
  }
  else {
    OnFlags |= ON_FREE_TX;             /* Set flag "OnFreeTxBuf" */
    SCI1C2_TIE = 0;                    /* Disable transmit interrupt */
  }
    if(OnFlags & ON_TX_CHAR) {         /* Is flag "OnTxChar" set? */
      UART_OnTxChar();                 /* If yes then invoke user event */
    }
    if(OnFlags & ON_FREE_TX) {         /* Is flag "OnFreeTxBuf" set? */
      UART_OnFreeTxBuf();              /* If yes then invoke user event */
    }
}

/*
** ===================================================================
**     Method      :  UART_InterruptError (bean AsynchroSerial)
**
**     Description :
**         The method services the error interrupt of the selected 
**         peripheral(s) and eventually invokes the bean's event(s).
**         This method is internal. It is used by Processor Expert only.
** ===================================================================
*/
ISR(UART_InterruptError)
{
  byte StatReg = getReg(SCI1S1);
  if(StatReg & (SCI1S1_OR_MASK|SCI1S1_NF_MASK|SCI1S1_FE_MASK|SCI1S1_PF_MASK)) { /* Is an error detected? */
    SerFlag |= COMMON_ERR;             /* If yes then set an internal flag */
    }
  SCI1D;                               /* Dummy read of data register - clear error bits */
  if(SerFlag & (COMMON_ERR)) {         /* Was any error set? */
    UART_OnError();                    /* If yes then invoke user event */
  }
}

/*
** ===================================================================
**     Method      :  UART_Init (bean AsynchroSerial)
**
**     Description :
**         Initializes the associated peripheral(s) and the bean's 
**         internal variables. The method is called automatically as a 
**         part of the application initialization code.
**         This method is internal. It is used by Processor Expert only.
** ===================================================================
*/
void UART_Init(void)
{
  SerFlag = 0;                         /* Reset flags */
  UART_InpLen = 0;                     /* No char in the receive buffer */
  InpIndxR = InpIndxW = 0;             /* Reset indices */
  UART_OutLen = 0;                     /* No char in the transmit buffer */
  OutIndxR = OutIndxW = 0;             /* Reset indices */
  /* SCI1C1: LOOPS=0,SCISWAI=0,RSRC=0,M=0,WAKE=0,ILT=0,PE=0,PT=0 */
  setReg8(SCI1C1, 0x00);               /* Configure the SCI */ 
  /* SCI1C3: R8=0,T8=0,TXDIR=0,??=0,ORIE=0,NEIE=0,FEIE=0,PEIE=0 */
  setReg8(SCI1C3, 0x00);               /* Disable error interrupts */ 
  /* SCI1C2: TIE=0,TCIE=0,RIE=0,ILIE=0,TE=0,RE=0,RWU=0,SBK=0 */
  setReg8(SCI1C2, 0x00);               /* Disable all interrupts */ 
  SCI1BDH = 0x00;                      /* Set high divisor register (enable device) */
  SCI1BDL = 0x21;                      /* Set low divisor register (enable device) */
      /* SCI1C3: ORIE=1,NEIE=1,FEIE=1,PEIE=1 */
  SCI1C3 |= 0x0F;                      /* Enable error interrupts */
  SCI1C2 |= ( SCI1C2_TE_MASK | SCI1C2_RE_MASK | SCI1C2_RIE_MASK); /*  Enable transmitter, Enable receiver, Enable receiver interrupt */
}



/* END UART. */


/*
** ###################################################################
**
**     This file was created by UNIS Processor Expert 2.97 [03.74]
**     for the Freescale HCS08 series of microcontrollers.
**
** ###################################################################
*/
