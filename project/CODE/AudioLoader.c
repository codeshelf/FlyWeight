/** ###################################################################
**     THIS BEAN MODULE IS GENERATED BY THE TOOL. DO NOT MODIFY IT.
**     Filename  : AudioLoader.C
**     Project   : FlyWeight
**     Processor : MC9S08GT60CFD
**     Beantype  : TimerInt
**     Version   : Bean 02.110, Driver 01.08, CPU db: 2.87.074
**     Compiler  : Metrowerks HCS08 C Compiler
**     Date/Time : 4/7/2006, 1:29 AM
**     Abstract  :
**         This bean "TimerInt" implements a periodic interrupt.
**         When the bean and its events are enabled, the "OnInterrupt"
**         event is called periodically with the period that you specify.
**         TimerInt supports also changing the period in runtime.
**         The source of periodic interrupt can be timer compare or reload
**         register or timer-overflow interrupt (of free running counter).
**     Settings  :
**         Timer name                  : TPM2 (16-bit)
**         Compare name                : TPM21
**         Counter shared              : Yes
**
**         High speed mode
**             Prescaler               : divide-by-4
**             Clock                   : 4998857 Hz
**           Initial period/frequency
**             Xtal ticks              : 1082
**             microseconds            : 135
**             seconds (real)          : 0.0001352
**             Hz                      : 7395
**             kHz                     : 7
**
**         Runtime setting             : none
**
**         Initialization:
**              Timer                  : Disabled
**              Events                 : Enabled
**
**         Timer registers
**              Counter                : TPM2CNT   [0061]
**              Mode                   : TPM2SC    [0060]
**              Run                    : TPM2SC    [0060]
**              Prescaler              : TPM2SC    [0060]
**
**         Compare registers
**              Compare                : TPM2C1V   [0069]
**
**         Flip-flop registers
**              Mode                   : TPM2C1SC  [0068]
**     Contents  :
**         Enable  - byte AudioLoader_Enable(void);
**         Disable - byte AudioLoader_Disable(void);
**
**     (c) Copyright UNIS, spol. s r.o. 1997-2005
**     UNIS, spol. s r.o.
**     Jundrovska 33
**     624 00 Brno
**     Czech Republic
**     http      : www.processorexpert.com
**     mail      : info@processorexpert.com
** ###################################################################*/

/* MODULE AudioLoader. */

#include "Events.h"
#include "PE_Error.h"
#include "AudioLoader.h"
#pragma MESSAGE DISABLE C2705          /* WARNING C2705: Possible loss of data */
#pragma MESSAGE DISABLE C5919          /* WARNING C5919: Conversion of floating to unsigned integral */
#pragma MESSAGE DISABLE C4002          /* Disable warning C4002 "Result not used" */

static bool EnUser;                    /* Enable device by user */
static word CmpVal;                    /* Value periodicly addded to compare register */
/*
** ===================================================================
**     Method      :  HWEnDi (bean TimerInt)
**
**     Description :
**         Enables or disables the peripheral(s) associated with the bean.
**         The method is called automatically as a part of the Enable and 
**         Disable methods and several internal methods.
**         This method is internal. It is used by Processor Expert only.
** ===================================================================
*/
static void HWEnDi(void)
{
  if (EnUser) {
    TPM2C1V=TPM2CNT + CmpVal;          /* Count current value for the compare register */
    TPM2C1SC_CH1F = 0;                 /* Reset request flag and */
    TPM2C1SC_CH1IE = 1;                /* Enable interrupt by compare register */
  } else {
    TPM2C1SC_CH1IE = 0;                /* Disable interrupt by compare register */
  }
}

/*
** ===================================================================
**     Method      :  AudioLoader_Enable (bean TimerInt)
**
**     Description :
**         Enables the bean - it starts the timer. Events may be
**         generated ("DisableEvent"/"EnableEvent").
**     Parameters  : None
**     Returns     :
**         ---             - Error code, possible codes:
**                           ERR_OK - OK
**                           ERR_SPEED - This device does not work in
**                           the active speed mode
** ===================================================================
*/
byte AudioLoader_Enable(void)
{
  if (!EnUser) {                       /* Is the device disabled by user? */
    EnUser = TRUE;                     /* If yes then set the flag "device enabled" */
    HWEnDi();                          /* Enable the device */
  }
  return ERR_OK;                       /* OK */
}

/*
** ===================================================================
**     Method      :  AudioLoader_Disable (bean TimerInt)
**
**     Description :
**         Disables the bean - it stops the timer. No events will be
**         generated.
**     Parameters  : None
**     Returns     :
**         ---             - Error code, possible codes:
**                           ERR_OK - OK
**                           ERR_SPEED - This device does not work in
**                           the active speed mode
** ===================================================================
*/
byte AudioLoader_Disable(void)
{
  if (EnUser) {                        /* Is the device enabled by user? */
    EnUser = FALSE;                    /* If yes then set the flag "device disabled" */
    HWEnDi();                          /* Disable the device */
  }
  return ERR_OK;                       /* OK */
}

/*
** ===================================================================
**     Method      :  AudioLoader_Init (bean TimerInt)
**
**     Description :
**         Initializes the associated peripheral(s) and the beans 
**         internal variables. The method is called automatically as a 
**         part of the application initialization code.
**         This method is internal. It is used by Processor Expert only.
** ===================================================================
*/
void AudioLoader_Init(void)
{
  EnUser=FALSE;                        /* Disable device */
  /* TPM2C1SC: CH1F=0,CH1IE=0,MS1B=0,MS1A=1,ELS1B=0,ELS1A=0,??=0,??=0 */
  setReg8(TPM2C1SC, 0x10);              
  AudioLoader_SetCV(0x02A3);           /* Store appropriate value to the compare register according to the value of mode identifier if selected High speed CPU mode */
  HWEnDi();
}

/*
** ===================================================================
**     Method      :  AudioLoader_Interrupt (bean TimerInt)
**
**     Description :
**         The method services the interrupt of the selected peripheral(s)
**         and eventually invokes the beans event(s).
**         This method is internal. It is used by Processor Expert only.
** ===================================================================
*/
ISR(AudioLoader_Interrupt)
{
  TPM2C1V+=CmpVal;                     /* Count and save new value to the compare register */
  TPM2C1SC_CH1F = 0;                   /* Reset compare interrupt request flag */
  AudioLoader_OnInterrupt();           /* Invoke user event */
}


/* END AudioLoader. */

/*
** ###################################################################
**
**     This file was created by UNIS Processor Expert 2.97 [03.74]
**     for the Freescale HCS08 series of microcontrollers.
**
** ###################################################################
*/
